/*
 * ex4.3.c
 *
 * Created: 8/11/2017 1:20:08 πμ
 * Author : Γιάννης
 */ 

#include <avr/io.h>

int main(void)
{
	DDRA = 0xff;					//Η θύρα A τίθεται έξοδος.
	DDRC = 0x00;					//Η θύρα C τίθεται είσοδος.
	
	volatile unsigned char t, new;	//Στον t αποθηκεύεται η είσοδος
									//και στον new αποθηκεύεται προσωρινά κάθε νέα είσοδος.
	unsigned char u, out;			//Στον u αποθηκεύεται η θέση του MSB της εισόδου
									//και στο out η τρέχουσα έξοδος.
	
	out = 0x80;						//Αρχικά απεικονίζεται το bit
	PORTA = out;					//στο MSB.
	
    /* Κάθε φορά που πατιέται και αφήνεται ένα από τα SW0-4 *
	 * εκτελείται μία αντίστοιχη λειτουργία στο απεικονιζόμενο bit *
	 * της θύρας B με προτεραιότητα από SW4 σε SW0 αν πατηθούν πολλά μαζί. */
    while (1)						//Διαρκής επανάληψη.
    {
		/*Αναμονή μέχρι να πατηθεί κάποιο από τα SW0-4*/
		while (!(t = PINC & 0x1f));		//Επαναλαμβάνει όσο τα 5 LSB του PINC είναι 0.
		
		/*Αναμονή μέχρι κάποιο κουμπί να μην είναι πλέον πατημένο. 
		 *Αν όσο είναι πατημένο κάποιο κουμπί πατηθεί κάποιο μεγαλύτερο,
		 *ενημερώνεται ο t, αλλιώς παραμένει ως έχει, μέχρι να ελευθερωθεί κάποιο από όλα.*/
		while((new = PINC & 0x1f) >= t) t = new;		//Αν πατηθεί κάποιο ενημερώνεται το t.
		t ^= new;						//Τώρα ο t έχει άσσους σε όσα κουμπιά από 1
										//έγιναν 0 (δηλαδή όσα αφέθηκαν).
		/*Εύρεση του μέγιστου ψηφίου της εισόδου που είναι άσσος.*/	
		u = 0x10;						//Αρχικοποιεί τον u στο 0x10,
		while (!(t & 0x10)){			//ώστε στη συνέχεια να ελέγχει αν είναι 0 ο t  
			t <<= 1;					//κι αν ναι, να ολισθαίνει κι άλλο τον t
			u >>= 1;					//και να χαμηλώνει το bit του u
		}								//μέχρις ότου το u να αποκτήσει τη θέση του μεγαλύτερου ψηφίου
										//του t που είναι 1.
		
		/*Εύρεση της λειτουργίας που καθορίζεται από το u και εκτέλεση της.*/
		switch (u){
			/*SW4 - Το bit έρχεται στο MSB.*/
			case 0x10:
				out = 0x80;				
				break;
			/*SW3 - Ολίσθηση κατά δύο θέσεις αριστερά.*/
			case 0x08:
				if (out & 0xC0) out >>= 6;		//Αν βρίσκεται στα δύο MSB πρέπει να πάει στην αρχή πάλι,
				else out <<= 2;					//οπότε το ολισθαίνουμε 6 θέσεις δεξιά.
				break;
			/*SW2 - Ολίσθηση κατά δύο θέσεις δεξιά.*/
			case 0x04:
				if (out & 0x03) out <<= 6;		//Όμοια για τα δύο LSB.
				else out >>= 2;
				break;
			/*SW1 - Ολίσθηση κατά μία θέση αριστερά.*/
			case 0x02:	
				if (out & 0x80) out >>= 7;		//Όμοια για το ένα MSB.
				else out <<= 1;
				break;
			/*SW0 - Ολίσθηση κατά μία θέση δεξιά.*/
			case 0x01:
				if (out & 0x01) out <<= 7;		//Όμοια για το ένα LSB.
				else out >>= 1;
				break;
			}
		PORTA = out;				//Απεικόνιση της εξόδου στη θύρα C.
    }
}



