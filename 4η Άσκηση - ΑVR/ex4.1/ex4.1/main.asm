;
; ex4.1.asm
;
; Created: 5/11/2017 1:05:34 μμ
; Author : Γιάννης
;


;;Αρχικοποίηση της στοίβας.
	LDI r16, HIGH(RAMEND)	;Το άνω byte του τέλους της μνήμης
	OUT SPH,r16				;τίθεται στον stack pointer (high)
	LDI r16, LOW(RAMEND)	;κι όμοια το κάτω byte.
	OUT SPL,r16

	ser r23					;r23=0xff				
	out DDRB,r23			;Θέτει τον B θύρα εξόδου.
	clr r23					;r23=0x00
	out DDRA,r23			;Θέτει τον Α θύρα εισόδου.
	ldi r23,1				;Αρχικοποίηση του μετρητή r23.
							;Θα χρησιμοποιηθεί για να αποθηκεύει την τρέχουσα κατάσταση.
;;Απεικονίζει ένα αναμμένο led που ολισθαίνει δεξιά κι αριστερά στην Β.
;;Σταματάει την κίνηση όταν δεν είναι πατημένο το PA0.
left:
	cpi r23,0x80			;Έλεγχος αν έχει φτάσει στο αριστερό άκρο.
	breq right				;Αν ναι, αρχίζει την κίνηση προς δεξιά.
    lsl r23					;Αλλιώς ολίσθηση αριστερά κατά μία θέση. 
	call stop_check			;Έλεγχος αν είναι πατημένο το PA0.
	out PORTB,r23			;Έχει επιστρέψει εδώ, όταν έχει πατηθεί το PA0 και δείχνει τη νέα τιμή.
	ldi r24,low(500)		;Τοποθετείται στον r25:r24 η τιμή 500
	ldi r25,high(500)		;για πρόκληση καθυστέρησης 500msec=0.5sec
	call wait_msec			;από την wait_msec.
	rjmp left				;Επανάληψη.
right:
	cpi r23,0x01			;Όμοια με προηγουμένως, έλεγχος αν έφτασε στο δεξί άκρο.
	breq left				;Αν ναι κίνηση προς τα αριστερά.
    lsr r23					;Αλλιώς ολίσθηση μία θέση δεξιά.
	call stop_check
	out PORTB,r23
	ldi r24,low(500)
	ldi r25,high(500)
	call wait_msec
	rjmp right

;;Ελέγχει αν είναι πατημένο το PA0 (και σταματάει την κίνηση αν όχι).
stop_check:
	in r22,PINA				;Διάβασμα της θύρας Α.
	andi r22,0x01			;Απομόνωση του LSB (PA0).
	cpi r22,0x01			;Έλεγχος αν είναι 1 (πατημένο).
	brne stop_check			;Αν όχι επανάληψη,
	ret						;αλλιώς επιστροφή.

;;Προκαλεί καθυστέρηση r25:r24 msec.
wait_msec:
	push r24				; 2 κύκλοι (0.250 μsec)
	push r25				; 2 κύκλοι
	ldi r24 , low(998)		; φόρτωσε τον καταχ. r25:r24 με 998 (1 κύκλος - 0.125 μsec)
	ldi r25 , high(998)		; 1 κύκλος (0.125 μsec)
	rcall wait_usec			; 3 κύκλοι (0.375 μsec), προκαλεί συνολικά καθυστέρηση 998.375 μsec
	pop r25					; 2 κύκλοι (0.250 μsec)
	pop r24					; 2 κύκλοι
	sbiw r24 , 1			; 2 κύκλοι
	brne wait_msec			; 1 ή 2 κύκλοι (0.125 ή 0.250 μsec)
	ret						; 4 κύκλοι (0.500 μsec)

;;Προκαλεί καθυστέρηση r25:r24 μsec.
wait_usec:
	sbiw r24 ,1				; 2 κύκλοι (0.250 μsec)
	nop						; 1 κύκλος (0.125 μsec)
	nop						; 1 κύκλος (0.125 μsec)
	nop						; 1 κύκλος (0.125 μsec)
	nop						; 1 κύκλος (0.125 μsec)
	brne wait_usec			; 1 ή 2 κύκλοι (0.125 ή 0.250 μsec)
	ret						; 4 κύκλοι (0.500 μsec)
 